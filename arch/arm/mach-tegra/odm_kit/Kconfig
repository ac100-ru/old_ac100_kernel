## arch/arm/mach-tegra/odm_kit/Kconfig
```kconfig
if MACH_TEGRA_GENERIC

choice
	prompt "Select ODM kit target board"

config TEGRA_ODM_PAZ00
	bool "COMPAL PAZ00 (NVIDIA T20) system"
	depends on ARCH_TEGRA_2x_SOC

endchoice

endif
```
